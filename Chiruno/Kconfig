## Chiruno/Kconfig
```kconfig
source "drivers/Chiruno/perfmgr/Kconfig"
source "drivers/Chiruno/smart_swappiness/Kconfig"
source "drivers/Chiruno/kernel_version/Kconfig"
source "drivers/Chiruno/slim_walt/Kconfig"
source "drivers/Chiruno/dynamic_readahead/Kconfig"
source "drivers/Chiruno/moon_binder_prio/Kconfig"
source "drivers/Chiruno/moon_mmap_opt/Kconfig"

menu "Chiruno module blacklist"

config XIAOMI_MODULE_BLACKLIST
	bool "Blacklist useless Xiaomi modules"
	default y

endmenu
```

## Chiruno/chiruno_islandopt/Kconfig
```kconfig
config CHIRUNO_ISLAND_OPT
    tristate "CHIRUNO_ISLAND_OPT to improve island experience "
	default n
    help
      Used to boost island.
```

## Chiruno/kernel_version/Kconfig
```kconfig
config CHIRUNO_KERNEL_VERSION
    tristate "MorizukuiNeko version"
    default n
```

## Chiruno/moon_binder_prio/Kconfig
```kconfig
config MI_MOON_BINDER_PRIO
       tristate "Xiaomi biner_prio module"
       default n
```

## Chiruno/moon_mmap_opt/Kconfig
```kconfig
config MOON_MMAP_OPT
	tristate "Moon high-order allocation optimization"
	depends on ANDROID_VENDOR_HOOKS
	default n
	help
	  Tune DMA-IOMMU high-order allocations and allow real-time tasks to
	  bypass direct reclaim throttling.
```

## Chiruno/smart_swappiness/Kconfig
```kconfig
config CHIRUNO_SMART_SWAPPINESS
	bool "Chiruno Kernel smart swappiness support"
	default n
	help
	  This option enables a swappiness controller for Android 5.15 GKI
	  kernels. It monitors available memory once per second. When memory
	  pressure is detected, it lowers vm_swappiness and the swappiness of
	  every memory cgroup. When the pressure clears, it restores the
	  boot-time swappiness value.

	  The controller is enabled by default only on devices in the 8 GiB RAM
	  range. On other devices it remains disabled at boot and can be enabled
	  through /proc/chiruno_swappiness/smart_swappiness.

	  Say Y here to compile this controller directly into the kernel.
```

## defconfig
```kconfig
# Xiaomi Features
CONFIG_MI_MEM_ENGINE=y
CONFIG_MI_WMARK=y
CONFIG_KSHRINK_SLABD=y
CONFIG_LZ4ASM=y
CONFIG_MI_UNION_POWER=n
# MIUI ADD: Xiaomi iorap2 from popsicle
CONFIG_MI_LAUNCH_BOOST=y
CONFIG_MI_LAUNCH_BOOST_PTE_PREREAD=y
CONFIG_MI_LAUNCH_BOOST_FILE_PREREAD=y
# MIUI ADD: Xiaomi iorap2 from popsicle END
CONFIG_MI_BINDER_PRIO=n
CONFIG_MI_RMAP_EFFICIENCY=y
CONFIG_MI_ASYNC_RECLAIM=y
# MIUI ADD: Performance_DisplayFluencyEnhance
CONFIG_MI_SW_SYNC=y
# Xiaomi Features END

# OnePlus Features
CONFIG_OPLUS_KSHRINK_LRUVECD=n
# OnePlus Features END

# ChirunoNeko Features
#CONFIG_CHIRUNO_ISLAND_OPT is not set
CONFIG_CHIRUNO_MI_PERFMGR=n
#CONFIG_CHIRUNO_FORCE_SELINUX_PERMISSIVE is not set
CONFIG_CHIRUNO_SMART_SWAPPINESS=y
CONFIG_CHIRUNO_KERNEL_VERSION=y
#ChirunoNeko EROFS FS OPT
CONFIG_CHIRUNO_EROFS_FS_THREAD_OPT=y
#ChirunoNeko Vendor Hooks
CONFIG_CHIRUNO_VH=n
#ChirunoNeko slim_walt governer
CONFIG_CHIRUNO_SLIM_WALT=n
#ChirunoNeko VIP Sched
CONFIG_CHIRUNO_VIP_SCHED=n
#ChirunoNeko Dynamic Readahead
CONFIG_CHIRUNO_DYNAMIC_READAHEAD=y
# ChirunoNeko Features END

#Moon Features
CONFIG_MI_MOON_BINDER_PRIO=y
CONFIG_MOON_MMAP_OPT=y
```

## xiaomi-features/xiaomi/Kconfig
```kconfig
source "drivers/xiaomi/mi_mem_engine/Kconfig"
source "drivers/xiaomi/mi_wmark/Kconfig"
source "drivers/xiaomi/lz4asm/Kconfig"
source "drivers/xiaomi/unionpower/Kconfig"
source "drivers/xiaomi/kshrink_slabd/Kconfig"
source "drivers/xiaomi/launch_boost/Kconfig"
source "drivers/xiaomi/mi_rmap_efficiency/Kconfig"
source "drivers/xiaomi/mi_async_reclaim/Kconfig"
source "drivers/xiaomi/binder_prio/Kconfig"
source "drivers/xiaomi/mi_sw_sync/Kconfig"
```

## xiaomi-features/xiaomi/binder_prio/Kconfig
```kconfig
config MI_BINDER_PRIO
	tristate "Binder priority boost for Xiaomi UI paths"
	depends on ANDROID_BINDER_IPC
	default n
	help
	  Boosts scheduling priority (SCHED_FIFO) for critical Android
	  binder transactions involving SurfaceFlinger, SystemUI,
	  MIUI Home, and CameraServer.  Improves UI responsiveness
	  on Xiaomi devices.
```

## xiaomi-features/xiaomi/launch_boost/Kconfig
```kconfig
config MI_LAUNCH_BOOST
	tristate "Xiaomi app launch boost (iorap2)"
	depends on MMU
	depends on MULTIUSER
	select TRACEPOINTS
	help
	  Kernel module for accelerating Android application cold start by
	  collecting file page access patterns during app launch and
	  performing predictive page pre-reading on subsequent launches.

	  The module hooks into the VFS read and page fault paths to record
	  which file pages an application accesses during startup. On later
	  launches of the same app, it pre-reads those pages into the page
	  cache, reducing I/O wait time during cold start.

	  Features:
	    - File page access pattern collection via vendor hooks
	    - Bitmap-based page tracking per file (up to 2GB per file)
	    - Multi-app tracking with LRU eviction (up to 100 apps)
	    - PTE-level hot page snapshot and swap-in acceleration
	    - Debug interface via /proc/iorap_node/

	  If unsure, say N.

config MI_LAUNCH_BOOST_PTE_PREREAD
	bool "PTE-based hot page snapshot and pre-reading"
	depends on MI_LAUNCH_BOOST
	default y
	help
	  Enable Page Table Entry (PTE) level hot page detection. This
	  feature walks the process page tables to identify pages that are
	  both referenced and young (actively used), then pre-reads them
	  via swap-in (anonymous pages) or fadvise (file pages).

	  This provides more accurate pre-reading than file-level
	  collection alone, as it captures the actual working set of
	  the application at the PTE level.

	  If unsure, say Y.

config MI_LAUNCH_BOOST_FILE_PREREAD
	bool "File-based pre-reading via vfs_fadvise"
	depends on MI_LAUNCH_BOOST
	depends on MI_LAUNCH_BOOST_PTE_PREREAD
	default n
	help
	  Enable file-based pre-reading using vfs_fadvise(WILLNEED).
	  This feature is used alongside PTE preread to pre-load file
	  pages identified during the snapshot phase.

	  Note: This is currently disabled by default as the PTE-based
	  approach handles file pages through the generic prepage path.

	  If unsure, say N.
```

## xiaomi-features/xiaomi/mi_async_reclaim/Kconfig
```kconfig
config MI_ASYNC_RECLAIM
       tristate "Async LRU page reclaim optimization"
       default n
       help
         Async page reclaim optimization. Offloads failed page trylock
         handling from the direct reclaim path to a dedicated kthread,
         reducing reclaim latency on the critical path.
```

## xiaomi-features/xiaomi/mi_rmap_efficiency/Kconfig
```kconfig
config MI_RMAP_EFFICIENCY
	tristate "Xiaomi rmap efficiency optimization"
	depends on ANDROID_VENDOR_HOOKS
	depends on ANDROID_VENDOR_OEM_DATA
	default n
	help
	  Page mapcount-based reclaim optimization backported from Android 6.6.
	  Protects heavily shared pages from expensive rmap walks and TLB
	  shootdowns while preserving the Android 5.15 vendor hook ABI.
```

## xiaomi-features/xiaomi/unionpower/Kconfig
```kconfig
config MI_UNION_POWER
    tristate "union power load monitor"
    default n
    help
      The case is used to monitor load
```
